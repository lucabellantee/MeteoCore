## build/Kconfig/arch/Kconfig
```kconfig
# Load Zephyr Arch Kconfig descriptions.
osource "C:/Users/lucab/zephyrproject/zephyr/arch/x86/Kconfig"
osource "C:/Users/lucab/zephyrproject/zephyr/arch/xtensa/Kconfig"
osource "C:/Users/lucab/zephyrproject/zephyr/arch/sparc/Kconfig"
osource "C:/Users/lucab/zephyrproject/zephyr/arch/riscv/Kconfig"
osource "C:/Users/lucab/zephyrproject/zephyr/arch/posix/Kconfig"
osource "C:/Users/lucab/zephyrproject/zephyr/arch/nios2/Kconfig"
osource "C:/Users/lucab/zephyrproject/zephyr/arch/mips/Kconfig"
osource "C:/Users/lucab/zephyrproject/zephyr/arch/arm64/Kconfig"
osource "C:/Users/lucab/zephyrproject/zephyr/arch/arm/Kconfig"
osource "C:/Users/lucab/zephyrproject/zephyr/arch/arc/Kconfig"
```

## build/Kconfig/boards/Kconfig
```kconfig
# Load Zephyr board Kconfig descriptions.
osource "C:/zephyrproject/zephyr/boards/st/nucleo_f446re/Kconfig"
```

## build/Kconfig/boards/Kconfig.defconfig
```kconfig
# Load Zephyr board defconfig descriptions.
osource "C:/zephyrproject/zephyr/boards/st/nucleo_f446re/Kconfig.defconfig"
```

## build/Kconfig/boards/Kconfig.nucleo_f446re
```kconfig
# Load board Kconfig descriptions.
osource "C:/zephyrproject/zephyr/boards/st/nucleo_f446re/Kconfig.nucleo_f446re"
```

## build/Kconfig/boards/Kconfig.sysbuild
```kconfig
# Load Sysbuild board Kconfig descriptions.
osource "C:/zephyrproject/zephyr/boards/st/nucleo_f446re/Kconfig.sysbuild"
```

## src/build/Kconfig/boards/Kconfig.sysbuild
```kconfig
# Load Sysbuild board Kconfig descriptions.
osource "C:/Users/lucab/zephyrproject/zephyr/boards/st/nucleo_f446re/Kconfig.sysbuild"
```
